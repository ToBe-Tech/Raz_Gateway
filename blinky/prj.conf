## prj.conf
```kconfig
CONFIG_GPIO=y
CONFIG_LOG=y
CONFIG_USE_SEGGER_RTT=y
CONFIG_LOG_BACKEND_RTT=y
CONFIG_LOG_BACKEND_UART=n
CONFIG_BT_HCI_UART=y
CONFIG_BT_UART_LOG=y

#
# Copyright (c) 2019 Nordic Semiconductor ASA
#
# SPDX-License-Identifier: LicenseRef-Nordic-5-Clause
#
# General config
CONFIG_NEWLIB_LIBC=y
CONFIG_ASSERT=n
CONFIG_REBOOT=y

# Network
CONFIG_NETWORKING=y
CONFIG_NET_NATIVE=n
CONFIG_NET_SOCKETS=y
CONFIG_NET_SOCKETS_OFFLOAD=y

# LTE link control
CONFIG_LTE_LINK_CONTROL=y
# CONFIG_LTE_AUTO_INIT_AND_CONNECT=n

# AT host

# Modem library
CONFIG_NRF_MODEM_LIB=y

# Disable Modem traces, since we need UART1 for HCI
CONFIG_NRF_MODEM_LIB_TRACE_ENABLED=n

# nRF Cloud
CONFIG_NRF_CLOUD_MQTT=y

# GPS
#CONFIG_GPS_USE_SIM=y

# For demo purposes, we acquire fix often
#CONFIG_GPS_SEARCH_INTERVAL=30
#CONFIG_GPS_SEARCH_TIMEOUT=15

# The two configurations below are required if using the nRF9160's built-in GPS
# CONFIG_NRF9160_GPS=y
# CONFIG_GPS_USE_NRF9160=y

# Library for buttons and LEDs
CONFIG_DK_LIBRARY=y
CONFIG_DK_LIBRARY_INVERT_LEDS=n

# Console for user association
CONFIG_CONSOLE_SUBSYS=y
# CONFIG_CONSOLE_GETCHAR=y

# Enable Bluetooth stack and libraries
CONFIG_BT=y
CONFIG_BT_H4=y
CONFIG_BT_WAIT_NOP=y
CONFIG_BT_CENTRAL=y
CONFIG_BT_PERIPHERAL=y
CONFIG_BT_GATT_CLIENT=y
CONFIG_BT_GATT_DM=y

# CONFIG_BT_GATT_DM_DATA_PRINT=y
CONFIG_BT_SCAN=y
CONFIG_BT_SCAN_FILTER_ENABLE=y
CONFIG_BT_SCAN_UUID_CNT=1
CONFIG_BT_EXT_ADV=y
CONFIG_UART_INTERRUPT_DRIVEN=y
CONFIG_BT_USER_PHY_UPDATE=y
# Heap and stacks
CONFIG_HEAP_MEM_POOL_SIZE=16384
CONFIG_MAIN_STACK_SIZE=8192
CONFIG_SYSTEM_WORKQUEUE_STACK_SIZE=4096
CONFIG_AT_MONITOR_HEAP_SIZE=1024
# Mitigation for NCSIDB-356
CONFIG_ZERO_LATENCY_IRQS=n

CONFIG_LOG_DEFAULT_LEVEL=4
CONFIG_THREAD_NAME=y
CONFIG_BT_UART=y
CONFIG_BT_GATTP=y
CONFIG_BT_GATTP_LOG_LEVEL_DBG=y
CONFIG_BT_GATT_AUTO_DISCOVER_CCC=y
CONFIG_PM=y
# Required to disable default behavior of deep sleep on timeout
CONFIG_PM_DEVICE=y 

################ UNCOMMENT FOR LOW POWER
# CONFIG_CONSOLE=n
# CONFIG_UART_CONSOLE=n
# CONFIG_PRINTK=n
# CONFIG_DEBUG=n
###################

CONFIG_BOOT_BANNER=n 
CONFIG_FLASH=y
CONFIG_FLASH_PAGE_LAYOUT=y
CONFIG_MPU_ALLOW_FLASH_WRITE=y
CONFIG_NVS=y
CONFIG_SETTINGS_NVS=y
CONFIG_NVS_LOG_LEVEL_DBG=y

CONFIG_MODEM_KEY_MGMT=y
```

## src/ble.h
```c
/*
 * Copyright (c) 2018 Nordic Semiconductor ASA
 *
 * SPDX-License-Identifier: LicenseRef-Nordic-5-Clause
 */

#ifndef _BLE_H_
#define _BLE_H_

#define BT_PER_COMP_NAME "TOBE"

#define GATEWAY_SERIAL_ID 0x0017 // 28

//define treatment struct
typedef struct {
    uint16_t delay;
    uint8_t type;
    bool send;

} treatment;

void ble_init(void);
void ble_scan_stop();
void ble_scan_start(void);
void ble_scan_start(void);
void adv_work_handler(void);
void ble_advertise_time(uint32_t adv_time);
void ble_advertise_battery(void);

uint8_t * get_mfg_data(void);

void reboot_work_handler(void);

void update_treatment_params(uint16_t delay, uint8_t type);

void stop_send_treatment(void);

void set_ble_adv_pm(void);

void ble_advertise_lte_vals(void);


void ble_set_adv_data_flag(uint8_t flag);
// uint32_t GetFreeMemorySize(void);

typedef struct {
    bool connected;
    bool is_pm;
} ble_conn_handler;

#endif /* _BLE_H_ */
```

## src/button.c
```c
#include "button.h"
#include "ble.h"
#include <pm/pm.h>
#include <pm/device.h>
#include <bluetooth/bluetooth.h>
#include <bluetooth/gatt.h>
#include <bluetooth/uuid.h>

LOG_MODULE_REGISTER(button, 4);
struct k_work_delayable advertising_normal_work;
struct k_work_delayable button_time_count;


extern struct k_work_delayable ble_scan_start_work;
#if defined(CONFIG_DK_LIBRARY)
uint8_t button_pressed = 0;
uint8_t button_count=0;
bool button_released = false;

bool ble_scan_flag = true;
bool button_block = false;
  uint8_t mfg_data_cpm[] = { 0xff, 0xfe, 0x01, 0x00 ,0x00, 0x00, 0x00, 0x00, GATEWAY_SERIAL_ID & 0xff, (GATEWAY_SERIAL_ID >> 8) & 0xff };
  const struct bt_data ad_cpm[] = {
	BT_DATA_BYTES(BT_DATA_GAP_APPEARANCE,
		(CONFIG_BT_DEVICE_APPEARANCE >> 0) & 0xff,
		(CONFIG_BT_DEVICE_APPEARANCE >> 8) & 0xff),
	BT_DATA_BYTES(BT_DATA_FLAGS, (BT_LE_AD_GENERAL | BT_LE_AD_NO_BREDR)),
	BT_DATA_BYTES(BT_DATA_UUID16_ALL,
		      BT_UUID_16_ENCODE(BT_UUID_HRS_VAL)),
			  
};

const struct bt_data sd_cpm[] = {
	BT_DATA_BYTES(BT_DATA_NAME_COMPLETE, BT_PER_COMP_NAME),
	BT_DATA(BT_DATA_MANUFACTURER_DATA, mfg_data_cpm, 10),
};

void button_time_count_handler(struct k_work *work)
{
  if (button_released) return;
  k_work_schedule(&button_time_count, Z_TIMEOUT_MS(1000));
  button_count++;
  printk("button_count: %d\n", button_count);
}

void block_button(void){
  button_block = true;
}

void release_button(void){
  button_block = false;
}

void button_handler(uint32_t button_states, uint32_t has_changed) {
  int err;
  printk("button handler\n");
  if (button_block){
    printk("button blocked\n");
    fault_beep();
    return;
  }
  if (has_changed & button_states &
      BIT(0)) {
    button_released = false;

    button_count=0;
    // k_work_cancel(&button_time_count);
    // k_work_cancel_sync(&button_time_count, K_FOREVER);
    k_work_schedule(&button_time_count, Z_TIMEOUT_MS(1000));

    LOG_DBG("button pressed\n");
    
    // k_work_schedule(&button_time_handler, Z_TIMEOUT_MS(1000));
    //stop ble advertisement
   
    }
    else{
      button_released = true;
      block_button();
      printk("button released\n");

      if (button_count < 1){
         long_beep();
        
          err =bt_le_adv_stop();
          if (err!=0) {
            printk("adv cannot be stopped (err %d)\n", err);
          }
          // k_sleep(K_SECONDS(1));
          err = bt_le_adv_start(BT_LE_ADV_CONN, ad_cpm, ARRAY_SIZE(ad_cpm),
                    sd_cpm, ARRAY_SIZE(sd_cpm));
          if (err) {
            printk("Advertising failed to start (err %d)\n", err);
          }
          set_ble_adv_pm();
          k_work_schedule(&advertising_normal_work, Z_TIMEOUT_MS(ADV_CPM_TIMEOUT));
          button_count=0;

      }

      else if(button_count > 2 && button_count <10){
        button_count=0;
        printk("scanning site");
        long_beep();
        k_work_schedule(&ble_scan_start_work, Z_TIMEOUT_MS(50));
        printk("calendar paused");
        pause_clock();
      }

      else if(button_count>10){
        button_count=0;
        printk("resetting device");
        long_beep();
        long_beep();
        factory_reset();
        // reset_device();
      }
      else{
        button_count=0;
        printk("button count not in range");
        release_button();
      }
      
      //cancel

      // k_work_schedule(&button_time_handler, Z_TIMEOUT_MS(1000));


    }
}



void adv_normal_mode_handler(void){
  adv_normal_mode();
  release_button();
}
#endif
```

## src/buzzer.h
```c
#ifndef _BUZZER_H_
#define _BUZZER_H_

#include <zephyr.h>
#include <device.h>
#include <drivers/gpio.h>


void dgc_buzz_success(void);

void dgc_buzz_fail(void);

#endif /* _BUZZER_H_ */
```

## src/fs.c
```c
#include "fs.h"


// const char * scratchData;


// #define FLASH_OFFSET            DT_FLASH_AREA_IMAGE_SCRATCH_OFFSET
// #define FLASH_PAGE_SIZE      DT_FLASH_ERASE_BLOCK_SIZE
// #define FLASH_SIZE                  DT_FLASH_AREA_IMAGE_SCRATCH_SIZE


// flashDev = device_get_binding( DT_FLASH_DEV_NAME );

// scratchData = (char *)FLASH_OFFSET;

// // Erase

// flash_write_protection_set( flashDev, false );
// flash_erase( flashDev, FLASH_OFFSET, FLASH_PAGE_SIZE );
// flash_write_protection_set( flashDev, true );

// // Write Block

// if (blockOffset + blockSize) > FLASH_SIZE )
// {
//   LOG_ERR( "Write Exceeds Scratchpad Size" );
//   return(-1);
// }

// blockOffset += FLASH_OFFSET;
// flash_write_protection_set( flashDev, false );
// flash_write( flashDev, blockOffset, blockData, blockSize );
// flash_write_protection_set( flashDev, true );


#include <device.h>
#include <fs/nvs.h>
#include "fs.h"
#include <zephyr.h>
#include <sys/reboot.h>
#include <string.h>
#include <drivers/flash.h>
#include <storage/flash_map.h>
#include <stdlib.h>

#define BUSINESS_ID 1
#define TIMESTAMP_ID 2
#define GPS_ID 3
#define STRING_ID 4
#define MAC_ID 5
#define STATUS_ID 6
#define POST_FLAG_ID 7
#define LISTINGS_NUM_ID 8
#define LISTINGS_ID 10
#define LISTINGS_SIZE_ID 9



static struct nvs_fs fs;

#define STORAGE_NODE_LABEL storage


// struct flash_pages_info info;
// fs.offset = DT_FLASH_AREA_STORAGE_OFFSET;
int rc = 0, cnt = 0, cnt_his = 0;
char biz_buf[2];
uint8_t timestamp[4], longarray[128];
uint8_t location[8];
uint8_t mac_nvs[6];
uint8_t status_nvs;
uint32_t reboot_counter = 0U, reboot_counter_his;
struct flash_pages_info info;
const struct device *flash_dev;
uint8_t listings_size[2] = {0x00,0x00};
// uint8_t * listings_raw;

uint8_t m = 0x9b;

uint8_t initial_listing_data[] = { 0x00};


void init_nvs(){
	
  
    flash_dev = FLASH_AREA_DEVICE(STORAGE_NODE_LABEL);
	if (!device_is_ready(flash_dev)) {
		printk("Flash device %s is not ready\n", flash_dev->name);
		return;
	}
	fs.offset = 0xb1000;
	rc = flash_get_page_info_by_offs(flash_dev, fs.offset, &info);
	if (rc) {
		printk("Unable to get page info\n");
		return;
	}
fs.sector_size = 0xf000;
fs.sector_count = 3U;

	rc = nvs_init(&fs, flash_dev->name);
	if (rc) {
		printk("Flash Init failed\n");
		return;
	}
    	printk("Sector size: %d | Sector count: %d | Total size = %d\n",info.size, 3, 3*info.size);
	// nvs_clear(&fs);

	//write initial_listing_data to flash
	ssize_t freespace = nvs_calc_free_space(&fs);
	printk("Remaining free space in nvs sector is %d Bytes\n", freespace);

}

uint8_t * nvs_read_timestamp(){
	rc = nvs_read(&fs, TIMESTAMP_ID, &timestamp, sizeof(timestamp));
	if (rc > 0) { /* item was found, show it */
		printk("Timestamp found\n");
	} else {
		// printk("Timestamp not found\n");
	
	} 
	return timestamp;
	
}

//big endian
int nvs_write_timestamp(uint32_t timestamp){
	int err = 0;
	uint8_t timestamp_arr[4] = {timestamp >> 24, timestamp >> 16, timestamp >> 8, timestamp};
	int rc = nvs_write(&fs, TIMESTAMP_ID, timestamp_arr, sizeof(timestamp_arr));
	if (rc > 0) 
	{
		printk("Timestamp written: ");
		for (int i = 0; i < 4; i++)
		{
			printk("%02X", timestamp_arr[i]);
		}
		printk("\n");
		err = SUCCESS;
		/* item was found, show it */
	}
	else{
		nvs_delete(&fs, TIMESTAMP_ID);
		printk("Timestamp write failed. retrying\n");
		nvs_write_timestamp(timestamp);
	}
	return err;

}


config_t * nvs_read_config(){
  
	config_t * config_read= malloc(sizeof(config_t));
	rc = nvs_read(&fs, BUSINESS_ID, &biz_buf, sizeof(biz_buf));
	if (rc > 0) { /* item was found, show it */
		printk("Id: %d, Business: %s\n", BUSINESS_ID, biz_buf);
		strcpy(config_read->biz_name, biz_buf);
	} else   {/* item was not found, add it */
	printk("No business found");
		strcpy(config_read->biz_name, "empty-biz");

		// (void)nvs_write(&fs, BUSINESS_ID, &biz_buf, strlen(biz_buf)+1);
	}

	rc = nvs_read(&fs, TIMESTAMP_ID, &timestamp, sizeof(timestamp));
	if (rc > 0) { /* item was found, show it */
		printk("Id: %d, timestamp: ", TIMESTAMP_ID);
		for (int n = 0; n < 4; n++) {
			printk("%x ", timestamp[n]);
		}
		printk("\n");
		config_read->timestamp = timestamp[3]<<24 | timestamp[2]<<16 | timestamp[1]<<8 | timestamp[0];
	} else   {/* item was not found, add it */
		printk("No timestamp found");
		config_read->timestamp = 0x00<<24 |  0x00<<16 |  0x00<<8 |  0x00;
		
		// (void)nvs_write(&fs, TIMESTAMP_ID, &timestamp, sizeof(timestamp));
	}

	rc = nvs_read(&fs, GPS_ID, &location, sizeof(location));
	if (rc > 0) { /* item was found, show it */
		printk("location read success\n");

			config_read->longitude[0] = location[0];
			config_read->longitude[1] = location[1];
			config_read->longitude[2] = location[2];
			config_read->longitude[3] = location[3];
			config_read->latitude[0] = location[4];
			config_read->latitude[1] = location[5];
			config_read->latitude[2] = location[6];
			config_read->latitude[3] = location[7];
			
	} else   {/* item was not found, add it */
		printk("No location found",
		       GPS_ID);
		config_read->longitude[0] = 0x00;
			config_read->longitude[1] = 0x00;
			config_read->longitude[2] = 0x00;
			config_read->longitude[3] = 0x00;
			config_read->latitude[0] = 0x00;
			config_read->latitude[1] = 0x00;
			config_read->latitude[2] = 0x00;
			config_read->latitude[3] = 0x00;

		// (void)nvs_write(&fs, GPS_ID, &location,
		// 	  sizeof(location));
	}
	//read status from flash
	rc = nvs_read(&fs, STATUS_ID, &status_nvs, sizeof(status_nvs));
	if (rc > 0) { /* item was found, show it */
		printk("Id: %d, status: %d\n",
			STATUS_ID, status_nvs);
		config_read->status = status_nvs;
	} else   {/* item was not found, add it */
		printk("No status found",
		       STATUS_ID);
		config_read->status = 0x01;
		nvs_write_status(config_read->status);
	}

	return config_read;

}

void factory_reset(){
	nvs_clear(&fs);
	printk("Factory reset\n");
	sys_reboot(SYS_REBOOT_COLD);
}

void nvs_delete_listings(void){
	int err;
	err = nvs_delete(&fs, LISTINGS_ID);
	if (err) {
		printk("Failed to delete listings\n");
	}
	
	err = nvs_delete(&fs, LISTINGS_SIZE_ID);
	if (err) {
		printk("Failed to delete listings size\n");
	}
	nvs_write_listings_num(0);
	
}
uint16_t nvs_read_listings_len(){
	uint16_t buf_len = 0;
	uint8_t listings_sz[2];
	rc = nvs_read(&fs, LISTINGS_SIZE_ID, &listings_sz, sizeof(listings_sz));
	if (rc > 0) { /* item was found, show it */
		buf_len = listings_sz[0]<<8 | listings_sz[1];
		return buf_len;
		// printk("Id: %d, listings_size: %d\n", LISTINGS_SIZE_ID, listings_size);
	} else   {/* item was not found, add it */
		printk("No listings_size found\n");
		return 0;
	}
	
}

void nvs_read_listings( uint8_t **list){
	uint16_t buf_len = 0;
	buf_len = nvs_read_listings_len();
	// uint8_t listings_raw[156] = {0};

	rc = nvs_read(&fs, LISTINGS_ID, *list, buf_len * sizeof(uint8_t));
	if (rc > 0) { /* item was found, show it */
		// printk("Id: %d, listings size: %d \n", LISTINGS_ID, buf_len);

		// printk("\n");
		
	} else   {/* item was not found, add it */
		printk("No listings found\n");
	}
	
}

void nvs_write_listings_len(uint16_t len){
	uint8_t list_len[2];
	list_len[0] = len>>8;
	list_len[1] = len;
	rc = nvs_write(&fs, LISTINGS_SIZE_ID, list_len, sizeof(list_len));
	if (rc>0) {
		printk("listings size written: %d \n", len);
	}
	else if (rc==0){
		nvs_delete(&fs, LISTINGS_SIZE_ID);
		printk("listing write failed. retrying\n");
		nvs_write_listings_len(len);
	}
}

void nvs_write_listings(uint8_t *write_list){
	uint16_t buf_len = 0;
	buf_len = nvs_read_listings_len();
	// printk("buff len: %d \n", buf_len);
	rc = nvs_write(&fs, LISTINGS_ID, write_list, buf_len * sizeof(uint8_t));

	if (rc > 0) { /* item was found, show it */
		printk("Listings write success\n");
		return;
		
	} else if (rc==0) {/* item was not found, add it */
		printk("listings write fail, retrying\n");
		nvs_delete(&fs, LISTINGS_ID);
		nvs_write_listings(write_list);
		
	}
	
}

int nvs_write_business_serial_id(uint16_t id){
	int err = 0;
	uint8_t biz_id[2] = {id>>8, id};
	rc = nvs_write(&fs, BUSINESS_ID, biz_id, sizeof(id));
	if (rc>0) {
		printk("business serial id Listing write success\n");
		err = SUCCESS;
	}
	else if (rc==0){
		printk("business serial id write fail, retrying\n");
		nvs_delete(&fs, BUSINESS_ID);
		return nvs_write_business_serial_id(id);
	}
	return err;
}

int nvs_write_location(uint8_t * gps){
	int err = 0;
	rc = nvs_write(&fs, GPS_ID, gps, sizeof(location));
	if (rc>0) {
		err = SUCCESS;
		printk("location write success: \n");
		for (int i = 0; i < 8; i++){
			printk("%02X ", gps[i]);
		}
		printk("\n");
	}
	else if (rc==0){
		printk("location write fail, retrying\n");
		nvs_delete(&fs, GPS_ID);
		return nvs_write_location(gps);
	}
	return err;
}

int nvs_write_mac(uint8_t * mac){
	int err = 0;

	rc = nvs_write(&fs, MAC_ID, mac, 6);
	if (rc>0) {
		printk("MAC write success\n");
		err = SUCCESS;
	}
	else if (rc==0){
		printk("MAC write fail, retrying\n");
		nvs_delete(&fs, MAC_ID);
		return nvs_write_mac(mac);
	}
	return err;
}

uint8_t * nvs_read_mac(){
	rc = nvs_read(&fs, MAC_ID, &mac_nvs, sizeof(mac_nvs));
	if (rc > 0) { /* item was found, show it */
		printk("Id: %d, mac: %02x:%02x:%02x:%02x:%02x:%02x\n",
		       MAC_ID, mac_nvs[0], mac_nvs[1], mac_nvs[2], mac_nvs[3], mac_nvs[4], mac_nvs[5]);
	} else   {/* item was not found, add it */
		printk("No mac found\n",
		       MAC_ID);
	}
	return mac_nvs;
}

int nvs_write_status(uint8_t status){
	int err = 0;
	rc = nvs_write(&fs, STATUS_ID, &status, sizeof(status));
	if (rc>0) {
		err = SUCCESS;
		printk("Status Listing write success\n");
	}
	else if (rc==0){
		printk("Status write fail, retrying\n");
		nvs_delete(&fs, STATUS_ID);
		return nvs_write_status(status);
	}
	return err;
}

uint8_t nvs_read_status(){
	rc = nvs_read(&fs, STATUS_ID, &status_nvs, sizeof(status_nvs));
	if (rc > 0) { /* item was found, show it */
		printk("Id: %d, status: %d\n",
		       STATUS_ID, status_nvs);
	} else   {/* item was not found, add it */
		printk("No status found\n",
		       STATUS_ID);
	}
	return status_nvs;
}

uint16_t nvs_read_business_id(void){
	uint16_t biz_id = 0;
	rc = nvs_read(&fs, BUSINESS_ID, &biz_buf, sizeof(biz_buf));
	if (rc > 0) { /* item was found, show it */
		printk("biz read success\n");
	} else   {/* item was not found, add it */
		printk("No business_id found\n",
		       BUSINESS_ID);
	}
	biz_id = biz_buf[0]<<8 | biz_buf[1];
	return biz_id;
}

uint8_t * nvs_read_location(void){
	rc = nvs_read(&fs, GPS_ID, &location, sizeof(location));
	if (rc > 0) { /* item was found, show it */
		printk("Id: %d, location: %d\n",
		       GPS_ID, location);
	} else   {/* item was not found, add it */
		printk("No location found\n",
		       GPS_ID);
	}
	return location;
}

uint8_t nvs_read_post_flag(void){
	uint8_t post_flag;
	rc = nvs_read(&fs, POST_FLAG_ID, &post_flag, sizeof(post_flag));
	if (rc > 0) { /* item was found, show it */
		printk("Id: %d, post_flag: %d\n",
		       POST_FLAG_ID, post_flag);
	} else   {/* item was not found, add it */
		printk("No post_flag found\n",
		       POST_FLAG_ID);
	}
	return post_flag;

}


void nvs_write_post_flag(uint8_t flag){
	rc = nvs_write(&fs, POST_FLAG_ID, &flag, sizeof(flag));
	if (rc>0) {
		printk("Post flag Listing write success\n");
	}
	else if (rc==0){
		printk("Post flag write fail, retrying\n");
		nvs_delete(&fs, POST_FLAG_ID);
		nvs_write_post_flag(flag);
	}
}


uint16_t nvs_read_listings_num(void){
	uint16_t list_num = 0;
	uint8_t list_num_buf[2];
	rc = nvs_read(&fs, LISTINGS_NUM_ID, &list_num_buf, sizeof(list_num_buf));
	if (rc > 0) { /* item was found, show it */
		printk("Id: %d, listings_num: %d\n",
		       LISTINGS_NUM_ID, list_num_buf);
	} else   {/* item was not found, add it */
		printk("No listings_num found\n",
		       LISTINGS_NUM_ID);
	}
	list_num = list_num_buf[0]<<8 | list_num_buf[1];
	return list_num;
}

void nvs_write_listings_num(uint16_t num){
	uint8_t list_num_buf[2] = {num>>8, num};
	rc = nvs_write(&fs, LISTINGS_NUM_ID, list_num_buf, sizeof(list_num_buf));
	if (rc>0) {
		printk("Listings num Listing write success\n");
	}
	else if (rc==0){
		printk("Listings num write fail, retrying\n");
		nvs_delete(&fs, LISTINGS_NUM_ID);
		nvs_write_listings_num(num);
	}
	
}
```

## src/fs.h
```c
#ifndef _FS_H_
#define _FS_H_


#include <zephyr.h>

#define SYS_REBOOT_WARM   0
#define SYS_REBOOT_COLD   1

#define FW_VERSION {0x00, 0x05,0x01}
#define HW_VERSION {0x00, 0x05,0x01}

#define MAX_UUID_SIZE 11
#define MAX_TARGET_UUID_SIZE 6

#define TIMESTAMP_SIZE 4

#define TARGET_UUID_OFFSET 12
#define FIRST_ENT_OFFSET 4 + TARGET_UUID_OFFSET
#define TARGET_REC_OFFSET 4 + FIRST_ENT_OFFSET
#define CLOUD_REC_OFFSET 4 + TARGET_REC_OFFSET
#define CLOUD_SIGN_OFFSET 1 + CLOUD_REC_OFFSET
#define DATA_ID_OFFSET 1 + CLOUD_SIGN_OFFSET
#define BODY_OFFSET 1 + DATA_ID_OFFSET
#define HEADER_SIZE BODY_OFFSET +11
#define MAX_LISTING_SIZE 100

enum {
	FAILURE =0,
	SUCCESS
};

typedef struct{
	uint32_t timestamp;
}events;

typedef struct{
	uint8_t mac_addr[6];
}device;

typedef struct{
	device * device;
	uint16_t devices_len;
}devices;


typedef struct{
	char biz_name[2]; 
	uint32_t timestamp;
	uint8_t longitude[4];
	uint8_t latitude[4];
	uint8_t status;
}config_t;

typedef struct {
	uint8_t longitude[4];
	uint8_t latitude[4];
}location_t;

// devices devices_init[] ={
// 	{
// 		.device = NULL,
// 		.devices_len = 0
// 	}

// };

typedef struct{
	uint8_t header_len;
	uint8_t listing_uuid[MAX_UUID_SIZE];
	uint8_t target_uuid[MAX_TARGET_UUID_SIZE];
	uint32_t first_ent_timestamp;
	uint32_t target_rec_timestamp;
	uint32_t cloud_rec_timestamp;
	uint8_t cloud_sign;
	uint8_t data_id;
	uint16_t body_len;
	uint8_t body[MAX_LISTING_SIZE];
} listing;






extern devices * devices_list;

// extern listings * listings;
void init_nvs(void);
config_t * nvs_read_config(void);
void factory_reset(void);

void nvs_read_listings(uint8_t ** list);

uint16_t nvs_read_listings_len(void);

uint8_t * nvs_read_timestamp(void);

int nvs_write_timestamp(uint32_t  timestamp);

int nvs_write_business_serial_id(uint16_t id);

int nvs_write_location(uint8_t * gps);

void nvs_write_listings(uint8_t *write_list);

void nvs_write_listings_len(uint16_t len);

uint8_t * nvs_read_mac(void);

int nvs_write_mac(uint8_t * mac);

int nvs_write_status(uint8_t status);

uint8_t nvs_read_status(void);

uint16_t nvs_read_business_id(void);

uint8_t * nvs_read_location(void);

uint8_t nvs_read_post_flag(void);

void nvs_write_post_flag(uint8_t flag);

void nvs_delete_listings(void);

uint16_t nvs_read_listings_num(void);

void nvs_write_listings_num(uint16_t num);

#endif
```

## src/led.c
```c
#include "led.h"

extern const struct device *dev;


void init_led(void){
    dev = device_get_binding("GPIO_0");

    gpio_pin_configure(dev,28, GPIO_OUTPUT); //GPIO P0.28 // buzzer

	gpio_pin_configure(dev, LED_RED, GPIO_OUTPUT);
	gpio_pin_configure(dev, LED_GREEN, GPIO_OUTPUT);
	gpio_pin_configure(dev, LED_BLUE, GPIO_OUTPUT);

}

void led_on(uint8_t led){
    gpio_pin_set(dev, led, 1);
}

void led_blue(void){
    led_on(LED_BLUE);
}

void led_green(void){
    led_on(LED_GREEN);
}

void led_red(void){
    led_on(LED_RED);
}

void led_off(uint8_t led){
    gpio_pin_set(dev, led, 0);
}

void leds_off(void){
    led_off(LED_RED);
    led_off(LED_GREEN);
    led_off(LED_BLUE);
}

void led_magenta(void){
    led_on(LED_RED);
    led_on(LED_BLUE);
}

void led_cyan(void){
    led_on(LED_GREEN);
    led_on(LED_BLUE);
}

void led_yellow(void){
    led_on(LED_RED);
    led_on(LED_GREEN);
}

void blink_led_yellow(void){
    uint32_t curr_time = get_timestamp_secs();
}
```

## src/listing.h
```c
#ifndef _LISTING_H_
#define _LISTING_H_

#include <zephyr.h>
#include "fs.h" 
#define PERIODIC_SENSOR_DATA_LISTING_LENGTH 28
#define IGNITION_DATA_LISTING_BODY_LENGTH 36
#define GATEWAY_STATUS_LISTING_BODY_LENGTH 24
#define DIAGNOSTICS_LISTING_BODY_LENGTH 13
#define CARTRIDGE_LISTING_BODY_LENGTH 5
#define FULL_LISTING_HEADER_LEN 33
#define MAX_LISTINGS_NUM 400
#define MAX_LISTING_BODY_SIZE 100

#define DGC_LISTING_LENGTH 50
#define SHORT_TREATMENT_LISTING_LENGTH 36



/*
    Concatenate listings to flash storage from the current listings instance 
*/
void save_listings_from_inst();

void compile_ignition_listings(uint8_t * adv_data, uint8_t len, device * devices);

void compile_periodic_listings(uint8_t * adv_data, uint8_t len, device * devices);

uint16_t get_listings_length(void);

uint8_t * get_all_listings_hex(void);

char *  get_single_listings_string(int len, int ind);

void handle_dgc(uint8_t *listings,uint16_t listings_len);

void send_treatment(uint8_t * listings);

void reset_listings(void);

void compile_gateway_status_listing(uint8_t len);

void remove_posted_listings(uint8_t * listings_hex_arr, uint16_t * del_listing_ind,uint16_t list_size,int listings_post_count,uint16_t listings_length);


typedef struct
{
    uint16_t listing_arr_pos;									// index of latest listing added
	uint16_t listing_arr_len;									// length of listing array

	listing listing_arr[MAX_LISTINGS_NUM];								// listings array


} listing_instance_t;

#endif
```

## src/lte.h
```c
#ifndef _LTE_H_
#define _LTE_H_
#include <stdint.h>


char * get_signal_buf(void);
uint8_t * get_signal_vals(void);
#endif /* _ALARM_H_ */
```

## src/services.c
```c
#include "services.h"

#include <zephyr.h>

#include <bluetooth/bluetooth.h>
#include <bluetooth/gatt.h>
#include "fs.h"
#include "listing.h"
#include <stdlib.h>
#include "clock.h"

#define BT_UUID_CONFIGURATION_S 0xfb, 0xc8, 0x51, 0x60, 0xc9, 0xc9, 0x52, 0x44,    \
			    0xad, 0x88, 0x87, 0xac, 0x00, 0x10, 0x2f, 0xe5
#define BT_UUID_CONFIGURATION_SERVICE   BT_UUID_DECLARE_128(BT_UUID_CONFIGURATION_S)

#define BT_UUID_FACTORY_RESET_C 0xfb, 0xc8, 0x51, 0x60, 0xc9, 0xc9, 0x52, 0x44,    \
			    0xad, 0x88, 0x87, 0xac, 0x01, 0x10, 0x2f, 0xe5
#define BT_UUID_FACTORY_RESET_CHARACTERISTIC   BT_UUID_DECLARE_128(BT_UUID_FACTORY_RESET_C)

#define BT_UUID_TIMESTAMP_C 0xfb, 0xc8, 0x51, 0x60, 0xc9, 0xc9, 0x52, 0x44,    \
			    0xad, 0x88, 0x87, 0xac, 0x02, 0x10, 0x2f, 0xe5
#define BT_UUID_TIMESTAMP_CHARACTERISTIC   BT_UUID_DECLARE_128(BT_UUID_TIMESTAMP_C)

#define BT_UUID_MAC_C 0xfb, 0xc8, 0x51, 0x60, 0xc9, 0xc9, 0x52, 0x44,    \
			    0xad, 0x88, 0x87, 0xac, 0x03, 0x10, 0x2f, 0xe5
#define BT_UUID_MAC_CHARACTERISTIC   BT_UUID_DECLARE_128(BT_UUID_MAC_C)

#define BT_UUID_SCAN_C 0xfb, 0xc8, 0x51, 0x60, 0xc9, 0xc9, 0x52, 0x44,    \
			    0xad, 0x88, 0x87, 0xac, 0x04, 0x10, 0x2f, 0xe5
#define BT_UUID_SCAN_CHARACTERISTIC   BT_UUID_DECLARE_128(BT_UUID_SCAN_C)

#define BT_UUID_CONFIG_C 0xfb, 0xc8, 0x51, 0x60, 0xc9, 0xc9, 0x52, 0x44,    \
			    0xad, 0x88, 0x87, 0xac, 0x05, 0x10, 0x2f, 0xe5
#define BT_UUID_CONFIG_CHARACTERISTIC   BT_UUID_DECLARE_128(BT_UUID_CONFIG_C)

#define BT_UUID_LISTING_S 0xfb, 0xc8, 0x51, 0x60, 0xc9, 0xc9, 0x52, 0x44,    \
			    0xad, 0x88, 0x87, 0xac, 0x00, 0x20, 0x2f, 0xe5
#define BT_UUID_LISTING_SERVICE   BT_UUID_DECLARE_128(BT_UUID_LISTING_S)

#define BT_UUID_LISTING_C 0xfb, 0xc8, 0x51, 0x60, 0xc9, 0xc9, 0x52, 0x44,    \
			    0xad, 0x88, 0x87, 0xac, 0x01, 0x20, 0x2f, 0xe5
#define BT_UUID_LISTING_CHARACTERISTIC   BT_UUID_DECLARE_128(BT_UUID_LISTING_C)

#define BT_UUID_LISTING_LEN_C 0xfb, 0xc8, 0x51, 0x60, 0xc9, 0xc9, 0x52, 0x44,    \
			    0xad, 0x88, 0x87, 0xac, 0x02, 0x20, 0x2f, 0xe5
#define BT_UUID_LISTING_LEN_CHARACTERISTIC   BT_UUID_DECLARE_128(BT_UUID_LISTING_LEN_C)


#define MAX_WRITE_SIZE 20
#define MAX_READ_SIZE 20

// extern bool clock_initialized;

static uint8_t config_ct[10];
static uint8_t config_ct_update;
static uint8_t factory_ct_update;
static uint8_t listing_ct[20];
static uint8_t listing_num_ct[10];
static uint8_t timestamp_ct[10];
static uint8_t mac_ct[10];
static uint8_t scan_ct[10];
static uint8_t config_ct[10];
static uint8_t factory_ct[10];
uint8_t g_listing_data[MAX_LISTING_ARRAY_SIZE];
int g_listing_idx = 0;
uint16_t listing_write_len = 0x0000;
int read_offset = 0;
int write_offset = 0;
uint8_t * listing_read_total;
uint8_t * listing_write_total;
uint16_t listing_len = 0x0000;

extern struct k_work_delayable ble_scan_start_work;

static ssize_t factory_read_ct(struct bt_conn *conn, const struct bt_gatt_attr *attr,
		       void *buf, uint16_t len, uint16_t offset)
{
	const char *value = attr->user_data;

	return bt_gatt_attr_read(conn, attr, buf, len, offset, value,
				 sizeof(factory_ct));
}

void reset_listing_read(){
	//TODO check if some of this is redundant
	printk("resetting listing read");
	read_offset = 0;
	free(listing_read_total);
	listing_len = 0;
	nvs_delete_listings();
	

}

static ssize_t listing_read_ct(struct bt_conn *conn, const struct bt_gatt_attr *attr,
		       void *buf, uint16_t len, uint16_t offset)
{
	// initial characteristic read request - read all listings
	if (!read_offset){
		printk("first char read\n");
		listing_len = nvs_read_listings_len();
		printk("len: %d\n", listing_len);
		listing_read_total = malloc(listing_len*sizeof(uint8_t));
		nvs_read_listings(&listing_read_total);
	}

	uint8_t chunk[MAX_READ_SIZE];

	// End of read handler
	// TODO: free memory
	// TODO: set proper condition for read end
	// TODO: test with mobile to see if condition works
	// TODO: test if delay is required between reads
	if (listing_len <=read_offset && read_offset != 0){
		// TODO verify this is correct
		printk("finished reading\n");
		printk("read_offset: %d\n", read_offset);
		printk("listin_len: %d\n", listing_len);
		printk("read_offset >= listing_len\n");
		nvs_delete_listings();//TODO make this smarter incase user loses all data
		read_offset = 0;
		free(listing_read_total);
		listing_len = 0;
		return 0;
	}
	if (!listing_len){
		printk("listing_len is 0\n");
		//set chunk to no values
		return;
	}
	int i=0;
	for (i=0; i < MAX_READ_SIZE; i++){
		if (read_offset < listing_len){
			chunk[i] = listing_read_total[read_offset];
			read_offset++;
		}
		else{
			printk("end of chunk: %d", i);
			break;
		}
	}
	return bt_gatt_attr_read(conn, attr, buf, len, offset, &chunk,
				i);
}

static ssize_t listing_write_ct(struct bt_conn *conn, const struct bt_gatt_attr *attr,
			const void *buf, uint16_t len, uint16_t offset,
			uint8_t flags)
{	

	printk("here again\n");
	uint8_t *p = (uint8_t *)buf;
	if (!write_offset){
		printk("first char write\n");
		printk("len: %d\n", listing_write_len);
		listing_write_total = malloc(listing_write_len*sizeof(uint8_t));
	}
	
	for (int i = 0; i < MAX_WRITE_SIZE && write_offset <listing_write_len ; i++){
		listing_write_total[write_offset] = p[i];
		write_offset++;
	}

	if (write_offset >= listing_write_len){
		printk("write_offset: %d\n", write_offset);
		printk("listing_write_len: %d\n", listing_write_len);
		printk("write_offset >= listing_write_len\n");
		// for (int i = 30; i < listing_write_len; i++){
		// 	printk("%02x ", listing_write_total[i]);
		// }
		printk("\n");
		switch (listing_write_len)
		{
		case DGC_LISTING_LENGTH:
			handle_dgc(listing_write_total, listing_write_len);
			break;
		case SHORT_TREATMENT_LISTING_LENGTH:
			send_treatment(listing_write_total);
			break;
		default:
			break;
		}
		
		// save_listings(listing_write_total, listing_write_len);
		free(listing_write_total);
		write_offset = 0;
	}
}

static ssize_t gateway_listing_len_read_ct(struct bt_conn *conn, const struct bt_gatt_attr *attr,
		       void *buf, uint16_t len, uint16_t offset)
{
	uint16_t read_len = 0;
	read_len = nvs_read_listings_len();
	printk("read_len: %d\n", read_len);
	return bt_gatt_attr_read(conn, attr, buf, len, offset, &read_len,
				sizeof(read_len));
}


static ssize_t factory_write_ct(struct bt_conn *conn, const struct bt_gatt_attr *attr,
			const void *buf, uint16_t len, uint16_t offset,
			uint8_t flags)
{
	uint8_t *value = attr->user_data;

	if (offset + len > sizeof(factory_ct)) {
		return BT_GATT_ERR(BT_ATT_ERR_INVALID_OFFSET);
	}

	memcpy(value + offset, buf, len);
	factory_ct_update = 1U;
	//get value from buffer
	uint8_t *p = (uint8_t *)buf;
	//print all bytes received in p 
	for (int i = 0; i < len; i++) {
		printk("%02x ", *p++);
	}
	// //print characteristic name
	// printk("config_write_ct: %d\n", p[0]);
	// //print value
	printk("char handle: %d\n",attr->handle);

	//switch case handle type
	switch (attr->handle) {
	case 0x0000:
		factory_reset();
		break;
	default:
		break;
	}
	return len;
}

static ssize_t gateway_listing_len_write_ct(struct bt_conn *conn, const struct bt_gatt_attr *attr,
			const void *buf, uint16_t len, uint16_t offset,
			uint8_t flags)
{
	uint8_t *p = (uint8_t *)buf;
	listing_write_len = p[0] << 8 | p[1];
	printk("listing_len_write: %d\n", listing_write_len);
	// nvs_write_listings_len(listing_write_len);
	// TODO: add write to memory
}


static ssize_t timestamp_read_ct(struct bt_conn *conn, const struct bt_gatt_attr *attr,
		       void *buf, uint16_t len, uint16_t offset)
{
	const char *value = attr->user_data;

	uint8_t timestamp[4];
	memcpy(timestamp,nvs_read_timestamp(),4);
	return bt_gatt_attr_read(conn, attr, buf, len, offset, timestamp,
				4);

	// return bt_gatt_attr_read(conn, attr, buf, len, offset, value,
	// 			 sizeof(timestamp_ct));
}

static ssize_t timestamp_write_ct(struct bt_conn *conn, const struct bt_gatt_attr *attr,
			const void *buf, uint16_t len, uint16_t offset,
			uint8_t flags)
{
	uint8_t *p = (uint8_t *)buf;
	uint32_t timestamp = p[0] << 24 | p[1] << 16 |  p[2] << 8 | p[3];
	printk("timestamp: %d\n", timestamp);
	//write to memory
	nvs_write_timestamp(timestamp);
	update_timestamp(timestamp);

	// if (!clock_initialized){
	// 	clock_init();
	// }
	// TODO: add write to memory
}


static ssize_t mac_read_ct(struct bt_conn *conn, const struct bt_gatt_attr *attr,
		       void *buf, uint16_t len, uint16_t offset)
{
	const char *value = attr->user_data;

	uint8_t mac[6];
	memcpy(mac,nvs_read_mac(),6);
	return bt_gatt_attr_read(conn, attr, buf, len, offset, mac,
				6);

	// return bt_gatt_attr_read(conn, attr, buf, len, offset, value,
	// 			 sizeof(timestamp_ct));
}

static ssize_t mac_write_ct(struct bt_conn *conn, const struct bt_gatt_attr *attr,
			const void *buf, uint16_t len, uint16_t offset,
			uint8_t flags)
{
	uint8_t *p = (uint8_t *)buf;
	uint8_t mac[6] = {p[0], p[1], p[2], p[3], p[4], p[5]};
	printk("mac: %d\n", mac);
	//write to memory
	nvs_write_mac(mac);
}


static ssize_t scan_read_ct(struct bt_conn *conn, const struct bt_gatt_attr *attr,
		       void *buf, uint16_t len, uint16_t offset)
{
	const char *value = attr->user_data;
	uint8_t scan[1];
	return bt_gatt_attr_read(conn, attr, buf, len, offset, scan,
				1);
}

static ssize_t scan_write_ct(struct bt_conn *conn, const struct bt_gatt_attr *attr,
			const void *buf, uint16_t len, uint16_t offset,
			uint8_t flags)
{
	printk("scan write\n");
	printk("scanning site");
	long_beep();
	k_work_schedule(&ble_scan_start_work, Z_TIMEOUT_MS(500));
	printk("calendar paused");
	pause_clock();
}

static ssize_t config_read_ct(struct bt_conn *conn, const struct bt_gatt_attr *attr,
		       void *buf, uint16_t len, uint16_t offset)
{
	const char *value = attr->user_data;

	uint8_t config_data[14];
	uint16_t biz_id = nvs_read_business_id();
	uint8_t time[4];
	memcpy(time,nvs_read_timestamp(),4) ;
	uint8_t loc[8];
	memcpy(loc,nvs_read_location(),8) ;
	uint8_t biz_arr[] = {biz_id >> 8, biz_id};
	//printk all the values being copied
	printk("\nbiz: ");
	for (size_t i = 0; i < 2; i++)
	{
		printk("%02X", biz_arr[i]);
	}
	printk("\n");
	printk("time: ");
	for (size_t i = 0; i < 4; i++)
	{
		printk(" %02X", time[i]);
	}
	printk("\n");
	printk("location: ");
	for (size_t i = 0; i < 8; i++)
	{
		printk("%02X", loc[i]);
	}
	printk("\n");

	
	memcpy(config_data,biz_arr ,2);
	memcpy(config_data+2,time,4);
	memcpy(config_data+6,loc,8);
	return bt_gatt_attr_read(conn, attr, buf, len, offset, config_data,
			14);
}

static ssize_t config_write_ct(struct bt_conn *conn, const struct bt_gatt_attr *attr,
			const void *buf, uint16_t len, uint16_t offset,
			uint8_t flags)
{
	printk("config write\n");
}

static void config_ct_ccc_cfg_changed(const struct bt_gatt_attr *attr, uint16_t value)
{
	/* TODO: Handle value */
}


/* Current Time Service Declaration */
BT_GATT_SERVICE_DEFINE(cts_cvs_list,
	BT_GATT_PRIMARY_SERVICE(BT_UUID_LISTING_SERVICE),
	BT_GATT_CHARACTERISTIC(BT_UUID_LISTING_CHARACTERISTIC, BT_GATT_CHRC_READ |
			       BT_GATT_CHRC_NOTIFY | BT_GATT_CHRC_WRITE,
			       BT_GATT_PERM_READ | BT_GATT_PERM_WRITE,
			       listing_read_ct, listing_write_ct, listing_ct),
	BT_GATT_CHARACTERISTIC(BT_UUID_LISTING_LEN_CHARACTERISTIC, BT_GATT_CHRC_READ |
			      BT_GATT_CHRC_WRITE,
			       BT_GATT_PERM_READ | BT_GATT_PERM_WRITE,
			       gateway_listing_len_read_ct, gateway_listing_len_write_ct, listing_num_ct),
);



BT_GATT_SERVICE_DEFINE(cts_cvs_config,
	BT_GATT_PRIMARY_SERVICE(BT_UUID_CONFIGURATION_SERVICE),
	BT_GATT_CHARACTERISTIC(BT_UUID_FACTORY_RESET_CHARACTERISTIC, BT_GATT_CHRC_READ |
			       BT_GATT_CHRC_WRITE,
			       BT_GATT_PERM_READ | BT_GATT_PERM_WRITE,
			       factory_read_ct, factory_write_ct, factory_ct),
	BT_GATT_CHARACTERISTIC(BT_UUID_TIMESTAMP_CHARACTERISTIC, BT_GATT_CHRC_READ |
			       BT_GATT_CHRC_WRITE,
			       BT_GATT_PERM_READ | BT_GATT_PERM_WRITE,
			       timestamp_read_ct, timestamp_write_ct, timestamp_ct),
	BT_GATT_CHARACTERISTIC(BT_UUID_MAC_CHARACTERISTIC, BT_GATT_CHRC_READ |
				BT_GATT_CHRC_WRITE,
				BT_GATT_PERM_READ | BT_GATT_PERM_WRITE,
				mac_read_ct, mac_write_ct, mac_ct),
	BT_GATT_CHARACTERISTIC(BT_UUID_SCAN_CHARACTERISTIC, BT_GATT_CHRC_READ |
				BT_GATT_CHRC_WRITE,
				BT_GATT_PERM_READ | BT_GATT_PERM_WRITE,
				scan_read_ct, scan_write_ct, scan_ct),
	BT_GATT_CHARACTERISTIC(BT_UUID_CONFIG_CHARACTERISTIC, BT_GATT_CHRC_READ |
				BT_GATT_CHRC_WRITE,
				BT_GATT_PERM_READ | BT_GATT_PERM_WRITE,
				config_read_ct, config_write_ct, config_ct),
	BT_GATT_CCC(config_ct_ccc_cfg_changed, BT_GATT_PERM_READ | BT_GATT_PERM_WRITE),
);
// void mtu_updated(struct bt_conn *conn, uint16_t tx, uint16_t rx)
// {
// 	printk("Updated MTU: TX: %d RX: %d bytes\n", tx, rx);
// }

// static struct bt_gatt_cb gatt_callbacks = {
// 	.att_mtu_updated = mtu_updated
// };
```
